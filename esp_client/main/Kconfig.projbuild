## esp_client/main/Kconfig.projbuild
```kconfig
menu "ESP_CLIENT Configuration"

    config EXAMPLE_USE_SEC_1
        bool
        default y
        prompt "Use Security Version 1"
        help
            Security version 1 used Curve25519 key exchange for establishing
            secure session between device and client during provisioning

    config EXAMPLE_USE_POP
        bool
        depends on EXAMPLE_USE_SEC_1
        default y
        prompt "Use proof-of-possession"
        help
            Proof-of-possession can be optionally used to prove that the device is indeed
            in possession of the user who is provisioning the device. This proof-of-possession
            is internally used to generate the shared secret through key exchange.

    config EXAMPLE_POP
        string "Proof-of-possession"
        default "abcd1234"
        depends on EXAMPLE_USE_POP

    config EXAMPLE_RESET_PROVISIONED
        bool
        default n
        prompt "Reset provisioned status of the device"
        help
            This erases the NVS to reset provisioned status of the device on every reboot.
            Provisioned status is determined by the Wi-Fi STA configuration, saved on the NVS.

    config EXAMPLE_AP_RECONN_ATTEMPTS
        int "Maximum AP connection attempts"
        default 5
        help
            Set the maximum connection attempts to perform when connecting to a Wi-Fi AP.

    config EXAMPLE_PROV_SHOW_QR
        bool "Show provisioning QR code"
        default y
        help
            Show the QR code for provisioning.

    config EXAMPLE_PROV_USING_BLUEDROID
        bool
        depends on (BT_BLUEDROID_ENABLED && (IDF_TARGET_ESP32C3 || IDF_TARGET_ESP32S3))
        select BT_BLE_42_FEATURES_SUPPORTED
        default y
        help
            This enables BLE 4.2 features for Bluedroid.
    
    choice WEBSOCKET_URI_SOURCE
        prompt "Websocket URI source"
        default WEBSOCKET_URI_FROM_STRING
        help
            Selects the source of the URI used in the example.

        config WEBSOCKET_URI_FROM_STRING
            bool "From string"

        config WEBSOCKET_URI_FROM_STDIN
            bool "From stdin"
    endchoice

    config WEBSOCKET_URI
        string "Websocket endpoint URI"
        depends on WEBSOCKET_URI_FROM_STRING
            # default "ws://ankemao.com:8082/"
            default "ws://192.168.31.186:8082/" # 本地服务器地址
        help
            URL of websocket endpoint this example connects to and sends echo
    
    config WEBSOCKET_PUBLIC_KEY
        string "Websocket public key"
        default "MTEwMDAy"

    config WEBSOCKET_SECRET_KEY
        string "Websocket secret key"
        default "MDI0MmFjMTEwMDAy"
    config DEVICE_ID
        int "Websocket secret key"
        default 1
endmenu
```
